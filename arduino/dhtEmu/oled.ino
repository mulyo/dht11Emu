
// ============================================================
// I2C SOFTWARE BIT-BANGING (manual, tanpa Wire)
// ============================================================
static void i2c_delay(void) {
    // ~4 us @ 16 MHz => 400 kHz cukup untuk SSD1306
    _delay_us(4);
}

static void i2c_sda_lo(void) {
    DDRC  |= (1 << SDA_PIN);   // SDA as output
    PORTC &= ~(1 << SDA_PIN);  // SDA LOW
}

static void i2c_sda_hi(void) {
    DDRC  &= ~(1 << SDA_PIN);  // SDA as input (open-drain, pull-up external)
    PORTC |= (1 << SDA_PIN);   // enable pull-up just in case
}

static void i2c_scl_lo(void) {
    DDRC  |= (1 << SCL_PIN);
    PORTC &= ~(1 << SCL_PIN);
}

static void i2c_scl_hi(void) {
    DDRC  &= ~(1 << SCL_PIN);
    PORTC |= (1 << SCL_PIN);
}

static void i2c_start(void) {
    i2c_sda_hi();
    i2c_scl_hi();
    i2c_delay();
    i2c_sda_lo();
    i2c_delay();
    i2c_scl_lo();
    i2c_delay();
}

static void i2c_stop(void) {
    i2c_sda_lo();
    i2c_delay();
    i2c_scl_hi();
    i2c_delay();
    i2c_sda_hi();
    i2c_delay();
}

// Kirim 1 byte I2C, return ACK status (ignore for OLED)
static uint8_t i2c_write_byte(uint8_t data) {
    for (uint8_t i = 0; i < 8; i++) {
        if (data & 0x80) i2c_sda_hi();
        else             i2c_sda_lo();
        i2c_delay();
        i2c_scl_hi();
        i2c_delay();
        i2c_scl_lo();
        data <<= 1;
    }
    // Clock pulse for ACK (master release SDA)
    i2c_sda_hi();
    i2c_delay();
    i2c_scl_hi();
    i2c_delay();
    i2c_scl_lo();
    return 0;
}

// ============================================================
// OLED SSD1306 128x64 DRIVER (I2C, tanpa library)
// ============================================================
#define OLED_CMD  0x00
#define OLED_DATA 0x40

static void oled_send(uint8_t type, uint8_t val) {
    i2c_start();
    i2c_write_byte((OLED_ADDR << 1) | 0); // write
    i2c_write_byte(type);                 // Co=0, D/C#
    i2c_write_byte(val);
    i2c_stop();
}

static void oled_cmd(uint8_t c)   { oled_send(OLED_CMD, c); }
static void oled_data(uint8_t d)  { oled_send(OLED_DATA, d); }

// Font 5x7 ASCII (32..126)
static const uint8_t PROGMEM font5x7[][5] = {
    {0x00,0x00,0x00,0x00,0x00},// 32 sp
    {0x00,0x00,0x5F,0x00,0x00},// 33 !
    {0x00,0x07,0x00,0x07,0x00},// 34 "
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    {0x08,0x08,0x2A,0x1C,0x08} //126 ~
};

static void oled_set_pos(uint8_t page, uint8_t col) {
    oled_cmd(0xB0 | (page & 0x07));           // Set page address
    oled_cmd(0x00 | (col & 0x0F));            // Set lower col
    oled_cmd(0x10 | ((col >> 4) & 0x0F));     // Set upper col
}

static void oled_clear(void) {
    for (uint8_t p = 0; p < 8; p++) {
        oled_set_pos(p, 0);
        for (uint8_t c = 0; c < 128; c++) {
            oled_data(0x00);
        }
    }
}

static void oled_init(void) {
    // Init sequence for SSD1306 128x64
    _delay_ms(20);
    oled_cmd(0xAE); // Display OFF
    oled_cmd(0xD5); // Set display clock div
    oled_cmd(0x80);
    oled_cmd(0xA8); // Set multiplex
    oled_cmd(0x3F); // 64 MUX
    oled_cmd(0xD3); // Set display offset
    oled_cmd(0x00);
    oled_cmd(0x40); // Set start line (0)
    oled_cmd(0x8D); // Charge pump
    oled_cmd(0x14); // Enable charge pump
    oled_cmd(0x20); // Memory mode
    oled_cmd(0x00); // Horizontal addressing
    oled_cmd(0xA1); // Segment remap (mirror)
    oled_cmd(0xC8); // COM scan dir (remap)
    oled_cmd(0xDA); // COM pins config
    oled_cmd(0x12);
    oled_cmd(0x81); // Contrast
    oled_cmd(0xCF);
    oled_cmd(0xD9); // Pre-charge period
    oled_cmd(0xF1);
    oled_cmd(0xDB); // VCOMH deselect
    oled_cmd(0x40);
    oled_cmd(0xA4); // Entire display on (A4=follow RAM, A5=all on)
    oled_cmd(0xA6); // Normal display (A6=normal, A7=inverse)
    oled_cmd(0xAF); // Display ON
    oled_clear();
}

// Cetak 1 karakter (5 kolom + 1 spasi)
static void oled_putc(char ch) {
    if (ch < 32 || ch > 126) ch = 32;
    uint8_t idx = ch - 32;
    for (uint8_t i = 0; i < 5; i++) {
        uint8_t b = pgm_read_byte(&font5x7[idx][i]);
        oled_data(b);
    }
    oled_data(0x00); // spasi 1 kolom
}

static void oled_puts(const char *s) {
    while (*s) oled_putc(*s++);
}

// Print angka desimal 2 digit
static void oled_put2(uint8_t v) {
    if (v > 99) v = 99;
    oled_putc('0' + (v / 10));
    oled_putc('0' + (v % 10));
}

// ============================================================
// millis() MENGGUNAKAN ARDUINO CORE (Timer0 sudah disetup oleh wiring.c)
// Tidak bikin millis() manual untuk menghindari konflik dengan Arduino core.
// ============================================================
static uint32_t get_millis(void) {
    return millis();
}

// ============================================================
// ADC READ MANUAL
// ============================================================
static void adc_init(void) {
    // Vref = AVcc (5V), left adjust OFF
    ADMUX  = (1 << REFS0);
    // Prescaler 128 => 16MHz/128 = 125 kHz, enable ADC
    ADCSRA = (1 << ADEN) | (1 << ADPS2) | (1 << ADPS1) | (1 << ADPS0);
}

static uint16_t adc_read(uint8_t ch) {
    ch &= 0x07;
    ADMUX = (ADMUX & 0xF8) | ch;
    ADCSRA |= (1 << ADSC);       // start
    while (ADCSRA & (1 << ADSC)); // wait
    return ADC;
}
